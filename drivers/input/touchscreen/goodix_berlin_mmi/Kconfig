## drivers/input/touchscreen/goodix_berlin_mmi/Kconfig
```kconfig
#
# Goodix touchscreen driver configuration
#

menuconfig TOUCHSCREEN_GOODIX_BRL
	tristate "Goodix berlin touchscreen"
	help
	  Say Y here if you have a Goodix berlin series touch controller
	  to your system.

	  If build module, say M.
	  If unsure, say N.

if TOUCHSCREEN_GOODIX_BRL

config TOUCHSCREEN_GOODIX_BRL_SPI
	bool "support SPI bus connection"
	help
		Say Y here if the touchscreen is connected via SPI bus.

config TOUCHSCREEN_GOODIX_BRL_I2C
	tristate "Goodix berlin touchscreen"
	help
	  Say Y here if you have a Goodix berlin series touch controller
	  to your system.

	  If build module, say M.
	  If unsure, say N.

config GTP_FOD
	bool "supports FOD"
	help
		Say Y here to support FOD.

config GTP_LIMIT_USE_SUPPLIER
	bool "supports using supplier"
	help
		Say Y here to support using supplier.

config GTP_PRODUCT
	string "Product the report rate table is selected for"
	default ""
	help
	  Moto product name, such as "tundra", that selects the per-product
	  report rate table (interpolation modes). It takes precedence over
	  TARGET_PRODUCT, which a ROM build sets to its own product name and a
	  standalone kernel build leaves unset. Leave empty to use
	  TARGET_PRODUCT.

endif
```

## drivers/input/touchscreen/touchscreen_mmi/Kconfig
```kconfig
config INPUT_TOUCHSCREEN_MMI
	tristate "Moto touchscreen gestures"
	default n
	help
	 Say Y here if you wish to include support for Moto touchscreen gestures.
	 If unsure, say N.

config TOUCHCLASS_MMI_DEBUG_INFO
	bool "Moto touchscreen gestures debug info"
	depends on INPUT_TOUCHSCREEN_MMI
	default n
	help
	 Say Y here if you wish to include support for Moto touchscreen gestures debugging info.
	 If unsure, say N.

config DRM_DYNAMIC_REFRESH_RATE
	bool "Moto DRM dynamic refresh rate"
	depends on INPUT_TOUCHSCREEN_MMI
	default n
	help
	 Say Y here if your panel supports drm dynamic refresh rate.
	 If unsure, say N.

config INPUT_TOUCHSCREEN_MMI_I2C
	bool "Touchscreen MMI I2C"

config TOUCHCLASS_MMI_GESTURE_POISON_EVENT
	bool "Moto gestures event poison"
	depends on INPUT_TOUCHSCREEN_MMI
	default n
	help
	 Say Y here if you wish to include support for Moto gestures event poison.
	 If unsure, say N.

config TOUCHCLASS_MMI_MULTIWAY_UPDATE_FW
        bool "Touchscreen Update FW"

config DRM_PANEL_NOTIFICATIONS
	bool "Moto DRM panel notifications"
	depends on INPUT_TOUCHSCREEN_MMI
	default n
	help
	 Say Y here if your panel includes support for drm notifications.
	 If unsure, say N.

config BOARD_USES_DOUBLE_TAP_CTRL
	bool "Board uses Double Tap Control"

config DRM_PANEL_EVENT_NOTIFICATIONS
	bool "Moto panel notifications through the QTI panel event notifier"
	depends on INPUT_TOUCHSCREEN_MMI && QCOM_PANEL_EVENT_NOTIFIER
	default n
	help
	 Say Y here to get the panel blank/unblank events from the 6.1
	 panel_event_notifier (the display driver triggers it) instead of
	 the 5.4 drm_panel notifier.
```

## drivers/platform/msm/Kconfig
```kconfig
# SPDX-License-Identifier: GPL-2.0-only

menu "Qualcomm technologies inc. MSM specific device drivers"
	depends on ARCH_QCOM

config EP_PCIE
	tristate "PCIe Endpoint mode support"
	select GENERIC_ALLOCATOR
	help
	  PCIe controller is in endpoint mode.
	  It supports the APIs to clients as a service layer, and allows
	  clients to enable/disable PCIe link, configure the address
	  mapping for the access to host memory, trigger wake interrupt
	  on host side to wake up host, and trigger MSI to host side.

config MSM_MHI_DEV
	tristate "Modem Device Interface Driver"
	depends on EP_PCIE
	help
	  This kernel module is used to interact with PCIe Root complex
	  supporting MHI protocol. MHI is a data transmission protocol
	  involving communication between a host and a device over shared
	  memory. MHI interacts with the IPA for supporting transfers
	  on the HW accelerated channels between Host and device.

config MSM_MHI_NET_DEV
	tristate "Modem Device Interface Net Driver"
	depends on MSM_MHI_DEV
	help
	  This kernel module enables communication over a MHI channel for
	  clients by creating a network device. This module interacts
	  with the MHI device driver to send and receive data to/from a
	  host.

config MSM_EXT_DISPLAY
	bool "MSM External Display Driver"
	depends on DRM && EXTCON
	help
	  Enabling this option adds MSM External Display Driver.
	  External Display driver was added to support the communication
	  between external display driver and its counterparts.
	  This should be enabled to support audio & video over HDMI or
	  DP for hot pluggable sink devices.

source "techpack/dataipa/Kconfig"
source "techpack/datarmnet/Kconfig"

endmenu
```

## techpack/camera/Kconfig
```kconfig
# SPDX-License-Identifier: GPL-2.0-only

config QTI_CAMERA_LAHAINA
	bool "Qualcomm Spectra camera driver (techpack/camera) for lahaina"
	depends on ARCH_QCOM && MEDIA_CONTROLLER && VIDEO_V4L2_SUBDEV_API
	depends on QCOM_DMABUF_HEAPS && QCOM_IOMMU_UTIL
	help
	  Build the Qualcomm camera-kernel techpack (CRM, sync, SMMU, CPAS,
	  CDM, IFE/CSID, ICP, JPEG, sensor modules) into the kernel with the
	  lahaina feature set from config/lahaina.mk.

config SPECTRA_ISP
	bool "enable camera ISP modele"
	help
	  This is enabling camera ISP module.
	  IFE camera driver file be included.
	  This will enable camera ISP driver to handle IFE driver.
	  Core camera driver to handle VFE HW.

config SPECTRA_TFE
	bool "enable camera tfe modele"
	help
	  This is enabling camera tfe module.
	  tfe module files will be included to enable tfe based driver,
	  files.

config SPECTRA_OPE
	bool "enable camera OPE modele"
	help
	  This is enabling camera OPE module.
	  Camera OPE driver file be included.
	  This will enable camera OPE driver to interact with,
	  other modules.

config SPECTRA_SENSOR
	bool "enable camera sensor modele"
	help
	  This is enabling camera sensor module.
	  sensor module files will be included to enable the driver.
	  eeprom, flash, csiphy all other module will be included
	  to make the sensor functional.
```

## techpack/dataipa/Kconfig
```kconfig
# SPDX-License-Identifier: GPL-2.0-only

config QTI_DATAIPA_LAHAINA
	bool "Qualcomm IPA/GSI driver (techpack/dataipa) for lahaina"
	depends on ARCH_QCOM && NET
	select IPA3
	select QCOM_QMI_HELPERS
	select QCOM_MDT_LOADER
	help
	  Build the Qualcomm dataipa techpack (GSI, IPA v3 core, rmnet_ipa,
	  WDI/offload clients) into the kernel with the lahaina feature set
	  from config/lahainadataipa.conf, together with the rmnet_mem page
	  pool from techpack/datarmnet-ext. The UAPI headers keep the 5.4
	  msm_ipa.h/rmnet_ipa_fd_ioctl.h numbering for the stock userspace.
```

## techpack/datarmnet/Kconfig
```kconfig
# SPDX-License-Identifier: GPL-2.0-only

config QTI_DATARMNET_LAHAINA
	bool "Qualcomm rmnet data core (techpack/datarmnet) for lahaina"
	depends on QTI_DATAIPA_LAHAINA
	select GRO_CELLS
	help
	  Build the Qualcomm rmnet core (rmnet_data netdevs, MAP
	  de/aggregation, DFC/WDA flow control, the RMNET_CORE genl and the
	  rmnet_ll low-latency channel over IPA) into the kernel, as 5.4 did,
	  for netmgrd's mobile data setup on top of rmnet_ipa0. The upstream
	  rmnet driver (CONFIG_RMNET) must stay off: both register the "rmnet"
	  link kind.
```

## techpack/video/Kconfig
```kconfig
# SPDX-License-Identifier: GPL-2.0-only

config QTI_VIDEO_LAHAINA
	bool "Qualcomm Technologies, Inc. lahaina video driver (msm_vidc)"
	depends on ARCH_QCOM && VIDEO_DEV
	select VIDEOBUF2_CORE
	select VIDEOBUF2_V4L2
	help
	  Build the msm_vidc V4L2 driver for the iris2 video core on
	  lahaina (SM8350) into the kernel, as on the 5.4 tundra kernel.
	  The stock Codec2/OMX components need it for hardware video
	  decoding and encoding.
```

## techpack/wlan/Kconfig
```kconfig
# SPDX-License-Identifier: GPL-2.0-only

config QTI_WLAN_LAHAINA
	bool "QCA6490 WLAN for lahaina"
	depends on ARCH_QCOM
	help
	  Build the CNSS platform drivers and the qcacld-3.0 WLAN host driver
	  from techpack/wlan into the kernel.

if QTI_WLAN_LAHAINA

source "techpack/wlan/platform/cnss2/Kconfig"
source "techpack/wlan/platform/cnss_genl/Kconfig"
source "techpack/wlan/platform/cnss_prealloc/Kconfig"
source "techpack/wlan/platform/cnss_utils/Kconfig"

config QCA_CLD_WLAN
	tristate "Qualcomm Atheros CLD WLAN module"
	help
	  Add support for the Qualcomm Atheros CLD WLAN host driver. Its feature
	  flags come from configs/qca6490_defconfig, not from Kconfig.

endif
```
