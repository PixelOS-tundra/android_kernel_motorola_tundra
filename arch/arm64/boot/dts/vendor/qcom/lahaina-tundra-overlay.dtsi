// SPDX-License-Identifier: GPL-2.0-only
/*
 * tundra board configuration shared by the evb/dvt1/dvt2 overlays, ported
 * from lahaina-moto-common-overlay-base.dtsi and the 5.4 tundra overlays.
 */

#include <dt-bindings/gpio/gpio.h>

&ufsphy_mem {
	compatible = "qcom,ufs-phy-qmp-v4-lahaina";

	vdda-phy-supply = <&pm8350_l5>;
	vdda-pll-supply = <&pm8350_l6>;
	vdda-phy-max-microamp = <91600>;
	vdda-pll-max-microamp = <19000>;

	status = "ok";
};

&ufshc_mem {
	vdd-hba-supply = <&gcc_ufs_phy_gdsc>;
	vdd-hba-fixed-regulator;

	vcc-supply = <&pm8350_l7>;
	vcc-voltage-level = <2504000 2950000>;
	vcc-max-microamp = <800000>;

	vccq-supply = <&pm8350_l9>;
	vccq-max-microamp = <900000>;

	qcom,vddp-ref-clk-supply = <&pm8350_l9>;
	qcom,vddp-ref-clk-max-microamp = <100>;

	qcom,vccq-parent-supply = <&pm8350_s12>;
	qcom,vccq-parent-max-microamp = <210000>;

	reset-gpios = <&tlmm 203 GPIO_ACTIVE_LOW>;

	status = "ok";
};
