// SPDX-License-Identifier: GPL-2.0-only
/*
 * tundra evb board overlay. Moto ABL picks the dtbo entry by these root
 * properties, so they match lahaina-tundra-evb-overlay.dts from 5.4
 * (including platinfo and the carrier channel-id-map); without them ABL
 * fails with "Board Dtbo blob not found". Board nodes move here as they
 * get ported.
 */

/dts-v1/;
/plugin/;

#include "carrier-channel-ids.dtsi"

/ {
	model = "Tundra";
	platinfo = "Qualcomm Technologies, Inc SM8350";
	compatible = "qcom,lahaina-Tundra", "qcom,lahaina-moto", "qcom,lahaina";
	qcom,msm-id = <415 0x20001>;
	qcom,board-id = <0x41 0x9100>;
};
